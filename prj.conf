## CMakeLists.txt
```
cmake_minimum_required(VERSION 3.13.1)

set(CMAKE_CXX_STANDARD 11)
set(CMAKE_CXX_STANDARD_REQUIRED ON)
set(PM_STATIC_YML_FILE ${CMAKE_CURRENT_LIST_DIR}/pm_static.yml)

find_package(Zephyr REQUIRED HINTS $ENV{ZEPHYR_BASE})

project(example-golioth-edge-impulse)

include(edge-impulse-sdk/cmake/utils.cmake)

add_definitions(-DEI_CLASSIFIER_TFLITE_ENABLE_CMSIS_NN=1
                -DARM_MATH_LOOPUNROLL
                )

add_subdirectory(edge-impulse-sdk/cmake/zephyr)

set(INCLUDES
    .
    src
    tflite-model
    model-parameters
    )
include_directories(${INCLUDES})

RECURSIVE_FIND_FILE(MODEL_FILES "tflite-model" "*.cpp")
list(APPEND SOURCE_FILES ${MODEL_FILES})

target_sources(app PRIVATE ${SOURCE_FILES})
target_sources(app PRIVATE src/main.cpp)
```

## prj.conf
```kconfig
CONFIG_CPP=y
CONFIG_GLIBCXX_LIBCPP=y
CONFIG_NEWLIB_LIBC=y
CONFIG_NEWLIB_LIBC_FLOAT_PRINTF=y
CONFIG_FPU=y

# Application
CONFIG_FLASH=y
CONFIG_FLASH_MAP=y
CONFIG_NVS=y
CONFIG_SETTINGS=y
CONFIG_SETTINGS_RUNTIME=y
CONFIG_GOLIOTH_SAMPLE_COMMON=y
CONFIG_GOLIOTH_SAMPLE_PSK_SETTINGS=y
CONFIG_GOLIOTH_SAMPLE_SETTINGS_AUTOLOAD=y
CONFIG_GOLIOTH_SAMPLE_SETTINGS_SHELL=y
CONFIG_LOG_BACKEND_GOLIOTH=y

# Sensors
CONFIG_SENSOR=y

CONFIG_ADXL362=y
CONFIG_ADXL362_TRIGGER_GLOBAL_THREAD=y
CONFIG_ADXL362_INTERRUPT_MODE=1
CONFIG_ADXL362_ABS_REF_MODE=1
CONFIG_ADXL362_ACCEL_RANGE_2G=y
CONFIG_ADXL362_ACCEL_ODR_12_5=y

CONFIG_ADXL372=n
CONFIG_FLASH_SHELL=n
CONFIG_SENSOR_SHELL=n

# Golioth Firmware SDK with all dependencies
CONFIG_GOLIOTH_FIRMWARE_SDK=y
CONFIG_GOLIOTH_STREAM=y
CONFIG_GOLIOTH_FW_UPDATE=y

CONFIG_FLASH=y
CONFIG_FLASH_MAP=y
CONFIG_STREAM_FLASH=y
CONFIG_IMG_MANAGER=y
CONFIG_IMG_ERASE_PROGRESSIVELY=y
```

## boards/thingy91_nrf9160_ns.conf
```kconfig
# General config
CONFIG_HEAP_MEM_POOL_SIZE=4096
CONFIG_NEWLIB_LIBC=y

# Networking
CONFIG_NET_SOCKETS_OFFLOAD=y
CONFIG_NET_IPV6=y
CONFIG_NET_IPV6_NBR_CACHE=n
CONFIG_NET_IPV6_MLD=n

# Increase native TLS socket implementation, so that it is chosen instead of
# offloaded nRF91 sockets
CONFIG_NET_SOCKETS_TLS_PRIORITY=35

# Modem library
CONFIG_NRF_MODEM_LIB=y
CONFIG_NRF_MODEM_LIB_ON_FAULT_APPLICATION_SPECIFIC=y

# LTE connectivity with network connection manager
CONFIG_LTE_CONNECTIVITY=y
CONFIG_NET_CONNECTION_MANAGER=y
CONFIG_NET_CONNECTION_MANAGER_MONITOR_STACK_SIZE=1024

# Increased sysworkq size, due to LTE connectivity
CONFIG_SYSTEM_WORKQUEUE_STACK_SIZE=2048

# Disable options y-selected by NCS for no good reason
CONFIG_MBEDTLS_KEY_EXCHANGE_DHE_PSK_ENABLED=n
CONFIG_MBEDTLS_KEY_EXCHANGE_DHE_RSA_ENABLED=n

# Generate MCUboot compatible images
CONFIG_BOOTLOADER_MCUBOOT=y

# NCS specific configuration
CONFIG_MBEDTLS_SSL_OUT_CONTENT_LEN=2048
CONFIG_MBEDTLS_SSL_IN_CONTENT_LEN=2048
```

## src/main.cpp
```c
/*
 * Copyright (c) 2024 Golioth, Inc.
 *
 * SPDX-License-Identifier: Apache-2.0
 */

#include <zephyr/kernel.h>
#include <zephyr/drivers/sensor.h>
#include <zephyr/device.h>
#include <zephyr/drivers/gpio.h>
#include <zcbor_encode.h>
#include "edge-impulse-sdk/classifier/ei_run_classifier.h"
#include "edge-impulse-sdk/dsp/numpy.hpp"
#include "model_metadata.h"

#include <zephyr/logging/log.h>
LOG_MODULE_REGISTER(ei_glth, LOG_LEVEL_DBG);

#include <golioth/client.h>
#include <golioth/stream.h>
#include <golioth/fw_update.h>
#include <samples/common/sample_credentials.h>
#include <string.h>

#include <samples/common/net_connect.h>

#include <app_version.h>

/* Current firmware version; update in VERSION */
static const char *_current_version =
    STRINGIFY(APP_VERSION_MAJOR) "." STRINGIFY(APP_VERSION_MINOR) "." STRINGIFY(APP_PATCHLEVEL);

struct golioth_client *client;
static K_SEM_DEFINE(connected, 0, 1);

static void on_client_event(struct golioth_client *client,
                            enum golioth_client_event event,
                            void *arg)
{
    bool is_connected = (event == GOLIOTH_CLIENT_EVENT_CONNECTED);
    if (is_connected)
    {
        k_sem_give(&connected);
    }
    GLTH_LOGI(TAG, "Golioth client %s", is_connected ? "connected" : "disconnected");
}

#define SW_0 DT_ALIAS(sw0)
static const struct gpio_dt_spec btn = GPIO_DT_SPEC_GET_OR(SW_0, gpios, {0});
static struct gpio_callback btn_cb_data;
static K_SEM_DEFINE(btn_press, 0, 1);

void btn_pressed(const struct device *dev, struct gpio_callback *cb, uint32_t pins)
{
    GLTH_LOGD(TAG, "Button pressed.");
    k_sem_give(&btn_press);
}

const struct device *accel = DEVICE_DT_GET_ONE(adi_adxl362);

static float readings[EI_CLASSIFIER_DSP_INPUT_FRAME_SIZE];

int sample_accel(size_t offset, size_t length, float *out_ptr)
{
    if (length > EI_CLASSIFIER_DSP_INPUT_FRAME_SIZE)
    {
        GLTH_LOGE(TAG, "Unexpected features length: %d", length);
        return 1;
    }
    GLTH_LOGD(TAG, "Collecting %u samples.", length);
    size_t i = offset;
    while (i - offset < length)
    {
        int err = sensor_sample_fetch(accel);
        if (err)
        {
            GLTH_LOGE(TAG, "Error fetching accelerometer data: %d", err);
            return 1;
        }
        struct sensor_value accel_x;
        struct sensor_value accel_y;
        struct sensor_value accel_z;
        sensor_channel_get(accel, SENSOR_CHAN_ACCEL_X, &accel_x);
        sensor_channel_get(accel, SENSOR_CHAN_ACCEL_Y, &accel_y);
        sensor_channel_get(accel, SENSOR_CHAN_ACCEL_Z, &accel_z);
        readings[i] = sensor_value_to_float(&accel_x);
        readings[i + 1] = sensor_value_to_float(&accel_y);
        readings[i + 2] = sensor_value_to_float(&accel_z);
        i += 3;
        /* Sample at 62.5 Hz */
        k_sleep(K_MSEC(16));
    }
    memcpy(out_ptr, readings + offset, length * sizeof(float));
    return 0;
}

enum golioth_status upload_accel_readings(uint32_t block_idx,
                                          uint8_t *block_buffer,
                                          size_t *block_size,
                                          bool *is_last,
                                          void *arg)
{
    uint32_t offset = block_idx * *block_size;
    uint32_t remaining = EI_CLASSIFIER_DSP_INPUT_FRAME_SIZE * sizeof(float) - offset;
    if (remaining <= *block_size)
    {
        *block_size = remaining;
        *is_last = true;
    }

    GLTH_LOGI(TAG, "Uploading accelerometer readings [idx: %u] [rem: %u]", block_idx, remaining);
    memcpy(block_buffer, (uint8_t *) readings + offset, *block_size);
    return GOLIOTH_OK;
}

int main()
{
    int err;

    GLTH_LOGD(TAG, "Starting Edge Impulse Golioth example...");

    net_connect();

    /* Note: In production, you would provision unique credentials onto each
     * device. For simplicity, we provide a utility to hardcode credentials as
     * kconfig options in the samples.
     */
    const struct golioth_client_config *client_config = golioth_sample_credentials_get();

    client = golioth_client_create(client_config);

    golioth_client_register_event_callback(client, on_client_event, NULL);

    k_sem_take(&connected, K_FOREVER);

    /* Setup OTA. */
    golioth_fw_update_init(client, _current_version);

    GLTH_LOGD(TAG, "Configuring button interrupts.");
    /* Configure button interrupt. */
    err = gpio_pin_configure_dt(&btn, GPIO_INPUT);
    if (err)
    {
        GLTH_LOGE(TAG, "Error %d: failed to configure %s pin %d", err, btn.port->name, btn.pin);
        return err;
    }

    err = gpio_pin_interrupt_configure_dt(&btn, GPIO_INT_EDGE_TO_ACTIVE);
    if (err)
    {
        GLTH_LOGE(TAG,
                  "Error %d: failed to configure interrupt on %s pin %d",
                  err,
                  btn.port->name,
                  btn.pin);
        return err;
    }

    GLTH_LOGD(TAG, "Registering button interrupt handlers.");
    /* Register interrupt handler. */
    gpio_init_callback(&btn_cb_data, btn_pressed, BIT(btn.pin));
    gpio_add_callback(btn.port, &btn_cb_data);

    ei_impulse_result_t result = {0};

    GLTH_LOGI(TAG, "Press button to sample data.");

    while (1)
    {
        k_sem_take(&btn_press, K_FOREVER);
        signal_t features_signal;
        features_signal.total_length = EI_CLASSIFIER_DSP_INPUT_FRAME_SIZE;
        features_signal.get_data = &sample_accel;

        GLTH_LOGD(TAG, "Running classifier.");
        EI_IMPULSE_ERROR res = run_classifier(&features_signal, &result, true);
        if (res != 0)
        {
            GLTH_LOGE(TAG, "Failed running classifier.");
            return 1;
        }

        uint8_t buf[EI_CLASSIFIER_LABEL_COUNT * 20] = {0};

        ZCBOR_STATE_E(zse, 1, buf, sizeof(buf), EI_CLASSIFIER_LABEL_COUNT);
        bool ok = zcbor_map_start_encode(zse, 1);
        if (!ok)
        {
            GLTH_LOGE(TAG, "Failed to start encoding map.");
            return 1;
        }
        for (size_t ix = 0; ix < EI_CLASSIFIER_LABEL_COUNT; ix++)
        {
            ok = zcbor_tstr_put_term(zse, result.classification[ix].label);
            if (!ok)
            {
                GLTH_LOGE(TAG, "Failed to encode label name.");
                return 1;
            }

            ok = zcbor_float32_put(zse, result.classification[ix].value);
            if (!ok)
            {
                GLTH_LOGE(TAG, "Failed to encode label value.");
                return 1;
            }
            GLTH_LOGI(TAG,
                      "%s: %.5f\n",
                      result.classification[ix].label,
                      result.classification[ix].value);
        }

        ok = zcbor_map_end_encode(zse, 1);
        if (!ok)
        {
            GLTH_LOGE(TAG, "Failed to close map.");
            return 1;
        }
        GLTH_LOGD(TAG, "Uploading classification results.");
        err = golioth_stream_set_sync(client,
                                      "class",
                                      GOLIOTH_CONTENT_TYPE_CBOR,
                                      buf,
                                      (intptr_t) zse->payload - (intptr_t) buf,
                                      5);
        if (err)
        {
            GLTH_LOGE(TAG, "Failed streaming classification results.");
        }

        GLTH_LOGD(TAG, "Uploading accelerometer readings.");
        err = golioth_stream_set_blockwise_sync(client,
                                                "accel",
                                                GOLIOTH_CONTENT_TYPE_OCTET_STREAM,
                                                upload_accel_readings,
                                                NULL);
        if (err)
        {
            GLTH_LOGE(TAG, "Failed streaming accelerometer readings.");
        }
    }
}
```
